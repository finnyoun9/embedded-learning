#include "SSD1306.h"

// 5x8 font, ASCII 32-127
static const uint8_t font5x8[] PROGMEM = {
    0x00, 0x00, 0x00, 0x00, 0x00, // space
    0x00, 0x00, 0x5F, 0x00, 0x00, // !
    0x00, 0x07, 0x00, 0x07, 0x00, // "
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    0x08, 0x04, 0x08, 0x10, 0x08, // ~
};

void SSD1306::cmd(uint8_t c) {
    Wire.beginTransmission(_addr);
    Wire.write(0x00); // command prefix
    Wire.write(c);
    Wire.endTransmission();
}

void SSD1306::data(uint8_t d) {
    Wire.beginTransmission(_addr);
    Wire.write(0x40); // data prefix
    Wire.write(d);
    Wire.endTransmission();
}

void SSD1306::begin() {
    Wire.begin();

    // SSD1306 init sequence
    cmd(0xAE); // display off
    cmd(0xD5); cmd(0x80); // clock div
    cmd(0xA8); cmd(0x3F); // multiplex = 64
    cmd(0xD3); cmd(0x00); // offset = 0
    cmd(0x40); // start line = 0
    cmd(0x8D); cmd(0x14); // charge pump on
    cmd(0x20); cmd(0x00); // horizontal mode
    cmd(0xA1); // seg remap
    cmd(0xC8); // com scan down
    cmd(0xDA); cmd(0x12); // com pins
    cmd(0x81); cmd(0xCF); // contrast
    cmd(0xD9); cmd(0xF1); // precharge
    cmd(0xDB); cmd(0x40); // vcom detect
    cmd(0xA4); // resume
    cmd(0xA6); // normal (not invert)
    cmd(0x2E); // deactivate scroll
    cmd(0xAF); // display on

    clear();
}

void SSD1306::clear() {
    memset(_buf, 0, sizeof(_buf));
    _x = 0;
    _y = 0;
}

void SSD1306::display() {
    for (uint8_t page = 0; page < 8; page++) {
        cmd(0xB0 + page);
        cmd(0x00); // lower column start
        cmd(0x10); // upper column start
        for (uint8_t col = 0; col < 128; col++) {
            data(_buf[page * 128 + col]);
        }
    }
}

void SSD1306::drawPixel(int16_t x, int16_t y, bool on) {
    if (x < 0 || x >= 128 || y < 0 || y >= 64) return;
    if (on)
        _buf[x + (y / 8) * 128] |= (1 << (y & 7));
    else
        _buf[x + (y / 8) * 128] &= ~(1 << (y & 7));
}

void SSD1306::drawChar(char c) {
    if (c < 32 || c > 126) c = '?';
    const uint8_t* glyph = font5x8 + (c - 32) * 5;

    for (uint8_t col = 0; col < 5; col++) {
        uint8_t line = pgm_read_byte(glyph + col);
        for (uint8_t row = 0; row < 8; row++) {
            drawPixel(_x + col, _y + row, line & (1 << row));
        }
    }
    // spacer column
    for (uint8_t row = 0; row < 8; row++) {
        drawPixel(_x + 5, _y + row, false);
    }
    _x += 6;
    if (_x > 128 - 6) { _x = 0; _y += 8; }
}

void SSD1306::print(const char* str) {
    while (*str) drawChar(*str++);
}

void SSD1306::print(int num) {
    char buf[12];
    snprintf(buf, sizeof(buf), "%d", num);
    print(buf);
}

void SSD1306::drawLine(uint8_t x0, uint8_t y0, uint8_t x1, uint8_t y1) {
    int dx = abs(x1 - x0), sx = x0 < x1 ? 1 : -1;
    int dy = -abs(y1 - y0), sy = y0 < y1 ? 1 : -1;
    int err = dx + dy;
    while (true) {
        drawPixel(x0, y0, true);
        if (x0 == x1 && y0 == y1) break;
        int e2 = 2 * err;
        if (e2 >= dy) { err += dy; x0 += sx; }
        if (e2 <= dx) { err += dx; y0 += sy; }
    }
}

void SSD1306::drawRect(uint8_t x, uint8_t y, uint8_t w, uint8_t h) {
    drawLine(x, y, x + w, y);
    drawLine(x + w, y, x + w, y + h);
    drawLine(x + w, y + h, x, y + h);
    drawLine(x, y + h, x, y);
}
